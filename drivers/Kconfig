## drivers/Kconfig
```kconfig
# Copyright (c) 2024 CATIE
# SPDX-License-Identifier: Apache-2.0

menu "Device Drivers"

rsource "gnss/Kconfig"

endmenu
```

## drivers/gnss/quectel/Kconfig
```kconfig
# Copyright (c) 2024 CATIE
# SPDX-License-Identifier: Apache-2.0

rsource "lx6/Kconfig"
```

## drivers/sensor/Kconfig
```kconfig
# Copyright (c) 2024 CATIE
# SPDX-License-Identifier: Apache-2.0

if SENSOR

rsource "quectel/Kconfig"

endif # SENSOR
```

## drivers/sensor/quectel/lx6g/Kconfig
```kconfig
# Copyright (c) 2024 CATIE
# SPDX-License-Identifier: Apache-2.0

menuconfig LX6G
    bool "Quectel Lx6G gnss sensor"
    default y
    depends on DT_HAS_QUECTEL_LX6G_ENABLED
    help
      Enable driver for Quectel Lx6G gnss sensor.
```

## dts/bindings/gnss/quectel,l86.yaml
```yaml
# Copyright (c) 2024 CATIE
# SPDX-License-Identifier: Apache-2.0

description: |
    Quectel L86 gnss modem

compatible: "quectel,l86"

include:
  - uart-device.yaml
  - gnss-pps.yaml
```

## dts/bindings/sensor/quectel,lx6g.yaml
```yaml
# Copyright (c) 2024 CATIE
# SPDX-License-Identifier: Apache-2.0

description: |
    Quectel Lx6G gnss sensor

compatible: "quectel,lx6g"

include: [sensor-device.yaml]
```
